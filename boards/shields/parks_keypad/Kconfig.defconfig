## boards/shields/parks_keypad/Kconfig.defconfig
```kconfig
if SHIELD_PARKS_KEYPAD_DONGLE

config ZMK_KEYBOARD_NAME
    default "Park's Dongle"

config ZMK_SPLIT
    default y

config ZMK_SPLIT_ROLE_CENTRAL
    default y

config ZMK_SPLIT_BLE_CENTRAL_PERIPHERALS
    default 1

endif

if SHIELD_PARKS_KEYPAD_PERIPHERAL

config ZMK_KEYBOARD_NAME
    default "Park's Keypad"

config ZMK_SPLIT
    default y

config ZMK_SPLIT_ROLE_CENTRAL
    default n

endif
```

## boards/shields/parks_keypad/Kconfig.shield
```kconfig
config SHIELD_PARKS_KEYPAD_DONGLE
    def_bool $(shields_list_contains,parks_keypad_dongle)

config SHIELD_PARKS_KEYPAD_PERIPHERAL
    def_bool $(shields_list_contains,parks_keypad_peripheral)
```
